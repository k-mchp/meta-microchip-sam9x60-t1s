## conf/distro/poky-mchp.conf
```bitbake
require conf/distro/poky.conf

DISTRO = "poky-mchp"

DISTRO_FEATURES:remove ?= "opengl wayland vulkan x11 3g nfc pulseaudio"

DISTRO_FEATURES:append = "pam ppp systemd avahi usrmerge wifi"
DISTRO_FEATURES_BACKFILL_CONSIDERED = "sysvinit"

# icu is needed to get egt
PACKAGECONFIG_DISTRO:pn-egt ?= "icu openssl freetype fontconfig"

EXTRA_OECONF:remove = "${DISABLE_STATIC}"
#PREFERRED_VERSION_swig = "3.0.8"

VIRTUAL-RUNTIME_syslog = "busybox-syslog"
VIRTUAL-RUNTIME_init_manager = "systemd"
VIRTUAL-RUNTIME_dev_manager = "systemd"

HOSTTOOLS:append = " xxd"

PACKAGECONFIG:remove:pn-rng-tools = "libjitterentropy"
```

## conf/layer.conf
```bitbake
# We have a conf and classes directory, add to BBPATH
BBPATH .= ":${LAYERDIR}"

# We have recipes-* directories, add to BBFILES
BBFILES += "${LAYERDIR}/recipes-*/*/*.bb \
            ${LAYERDIR}/recipes-*/*/*.bbappend"

BBFILE_COLLECTIONS += "meta-microchip-sam9x60-t1s"
BBFILE_PATTERN_meta-microchip-sam9x60-t1s = "^${LAYERDIR}/"
BBFILE_PRIORITY_meta-microchip-sam9x60-t1s = "11"

LAYERDEPENDS_meta-microchip-sam9x60-t1s = "core"
LAYERSERIES_COMPAT_meta-microchip-sam9x60-t1s = "scarthgap"
```
